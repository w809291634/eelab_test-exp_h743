/*********************************************************************************************
* 文件: delay.c
* 作者：zonesion 2016.12.22
* 说明：延时相关函数  
* 修改：
* 注释：当用到contiki操作系统时需将SYSTEM_SUPPORT_CONTIKI置1，在delay.h文件中
*********************************************************************************************/

/*********************************************************************************************
* 头文件
*********************************************************************************************/
#include "delay.h"

static uint32_t g_fac_us = 0;       /* us延时倍乘数 */

/*********************************************************************************************
* 名称：delay_init
* 功能：初始化延迟函数
* 参数：sysclk: 系统时钟频率, 即CPU频率(HCLK), 等于系统主频, 单位 Mhz
* 返回：无
* 修改：无
* 注释：无
*********************************************************************************************/
void delay_init(uint16_t sysclk)
{
    g_fac_us = sysclk;                                  /* 不论是否使用OS,g_fac_us都需要使用 */
}

/*********************************************************************************************
* 名称：delay_us
* 功能：延时nus
* 参数：nus: 要延时的us数
* 返回：无
* 修改：无
* 注释：无论是否使用OS, 都是用时钟摘取法来做us延时
            nus取值范围: 0 ~ (2^32 / fac_us) (fac_us一般等于系统主频, 自行套入计算)
*********************************************************************************************/
void delay_us(uint32_t nus)
{
    uint32_t ticks;
    uint32_t told, tnow, tcnt = 0;
    uint32_t reload = SysTick->LOAD;        /* LOAD的值 */
    ticks = nus * g_fac_us;                 /* 需要的节拍数 */

    told = SysTick->VAL;                    /* 刚进入时的计数器值 */
    while (1)
    {
        tnow = SysTick->VAL;
        if (tnow != told)
        {
            if (tnow < told)
            {
                tcnt += told - tnow;        /* 这里注意一下SYSTICK是一个递减的计数器就可以了 */
            }
            else
            {
                tcnt += reload - tnow + told;
            }
            told = tnow;
            if (tcnt >= ticks) 
            {
                break;                      /* 时间超过/等于要延迟的时间,则退出 */
            }
        }
    }
} 

/*********************************************************************************************
* 名称：delay_ms
* 功能：延时nms
* 参数：nms: 要延时的ms数 (0< nms <= (2^32 / fac_us / 1000))(fac_us一般等于系统主频, 自行套入计算)
* 返回：无
* 修改：无
* 注释：无
*********************************************************************************************/
void delay_ms(uint16_t nms)
{
    delay_us((uint32_t)(nms * 1000));                   /* 普通方式延时 */
}

/*********************************************************************************************
* 名称：HAL_Delay
* 功能：HAL库内部函数用到的延时
* 参数：Delay : 要延时的毫秒数
* 返回：无
* 修改：无
* 注释：HAL库的延时默认用Systick，如果我们没有开Systick的中断会导致调用这个延时后无法退出
*********************************************************************************************/
void HAL_Delay(uint32_t Delay)
{
     delay_ms(Delay);
}
